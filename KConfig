## boards/waveshare/esp32s3_1_47_tft/board.yml
```yaml
board:
  name: esp32s3_1_47_tft
  full_name: ESP32-S3-1.47
  vendor: waveshare
  socs:
  - name: esp32s3
```

## boards/waveshare/esp32s3_1_69_tft_touch/esp32s3_1_69_tft_touch_esp32s3_procpu_defconfig
```kconfig
# Copyright (c) 2024 Joel Guittet
# SPDX-License-Identifier: Apache-2.0

CONFIG_CONSOLE=y
CONFIG_SERIAL=y
CONFIG_UART_CONSOLE=y
CONFIG_GPIO=y

# waveshare 1.69" Touch TFT display
CONFIG_PWM=y
CONFIG_SPI=y
CONFIG_DISPLAY=y

CONFIG_INPUT=y
CONFIG_INPUT_CST816S=y
CONFIG_INPUT_CST816S_INTERRUPT=y
```

## boards/waveshare/esp32s3_1_8_amoled_touch/Kconfig.esp32s3_1_8_amoled_touch
```kconfig
# Copyright (c) 2024 Joel Guittet
# SPDX-License-Identifier: Apache-2.0

config BOARD_ESP32S3_1_8_AMOLED_TOUCH
	select SOC_ESP32S3_R8
	select SOC_ESP32S3_PROCPU if BOARD_ESP32S3_1_69_TFT_TOUCH_ESP32S3_PROCPU
	select SOC_ESP32S3_APPCPU if BOARD_ESP32S3_1_69_TFT_TOUCH_ESP32S3_APPCPU
```

## boards/waveshare/esp32s3_1_8_amoled_touch/esp32s3_1_8_amoled_touch_esp32s3_procpu_defconfig
```kconfig
# Copyright (c) 2024 Joel Guittet
# SPDX-License-Identifier: Apache-2.0
# waveshare 1.8 AMOELED touch
# https://files.waveshare.com/wiki/ESP32-S3-Touch-AMOLED-1.8/ESP32-S3-Touch-AMOLED-1.8.pdf

CONFIG_CONSOLE=y
CONFIG_SERIAL=y
CONFIG_UART_CONSOLE=y
CONFIG_GPIO=y

CONFIG_SPI=y
CONFIG_I2C=y

CONFIG_DISPLAY=y
CONFIG_REGULATOR=y
CONFIG_GPIO_TCA9544APWR=y
CONFIG_GPIO_TCA9544APWR_INIT_PRIORITY=80
```

## drivers/Kconfig
```kconfig
rsource "**/tca9544apwr/tca9544apwr.Kconfig"
rsource "**/pcf85063a/pcf85063a.Kconfig"
rsource "**/sh8601a/sh8601a.Kconfig"

orsource "**/*.Kconfig"
```

## dts/bindings/display/shenge,sh8601a.yaml
```yaml
description: ST7789V 320x240 display controller

compatible: "shenge,sh8601a"

include: [mipi-dbi-spi-device.yaml, display-controller.yaml]

properties:
  x-offset:
    type: int
    required: true
    description: The column offset in pixels of the LCD to the controller memory

  y-offset:
    type: int
    required: true
    description: The row offset in pixels of the LCD to the controller memory

  mipi-mode:
    required: true
```

## dts/bindings/rtc/nxp,pcf85063a.yaml
```yaml
description: PCF85063A RTC

compatible: "nxp,pcf85063a"

include: [i2c-device.yaml, rtc-device.yaml]

properties:
  int1-gpios:
    type: phandle-array
    description: |
      GPIO connected to the PCF85063A INT interrupt output. This signal is open-drain, active low.
```

## sdk/boards/waveshare/esp32s3_1_47_tft/Kconfig.esp32s3_1_47_tft
```kconfig
# Copyright (c) 2024 Joel Guittet
# SPDX-License-Identifier: Apache-2.0

config BOARD_ESP32S3_1_47_TFT
	select SOC_ESP32S3_WROOM_N16R8
	select SOC_ESP32S3_PROCPU if BOARD_ESP32S3_1_47_TFT_ESP32S3_PROCPU
	select SOC_ESP32S3_APPCPU if BOARD_ESP32S3_1_47_TFT_ESP32S3_APPCPU
```

## sdk/dts/bindings/gpio/ti,tca9544pwr.yaml
```yaml
# Binding for TI TCA9544A, compatible with NXP PCA9544A

description: Texas Instruments TCA9544A I2C-based GPIO expander

compatible: "ti,tca9544apwr"

include: [gpio-controller.yaml, i2c-device.yaml]

properties:
  reset-gpios:
    type: phandle-array
    description:
      Reset GPIO pin (active-low)
      Left blank if the device does not have reset pin
      or the pin is not connected in your application.

  int-gpios:
    type: phandle-array
    description:
      Interrupt GPIO pin (active-low open-drain)
      Left blank if the pin is not connected in your
      application.

  "#gpio-cells":
    const: 2

gpio-cells:
  - pin
  - flags
```

## sdk/waveshare/esp32s3_1_47_tft/esp32s3_1_47_tft_esp32s3_procpu_defconfig
```kconfig
# Copyright (c) 2024 Joel Guittet
# SPDX-License-Identifier: Apache-2.0

CONFIG_CONSOLE=y
CONFIG_SERIAL=y
CONFIG_UART_CONSOLE=y
CONFIG_GPIO=y

# waveshare 1.47" TFT display
CONFIG_SPI=y
CONFIG_DISPLAY=y
```

## sdk/waveshare/esp32s3_1_69_tft_touch/Kconfig.defconfig
```kconfig
# Copyright (c) 2024 Joel Guittet
# SPDX-License-Identifier: Apache-2.0

if BOARD_ESP32S3_1_69_TFT_TOUCH_ESP32S3_PROCPU

config KERNEL_MEM_POOL
	default y

endif # BOARD_ESP32S3_1_47_TFT_ESP32S3_PROCPU
```

## sdk/waveshare/esp32s3_1_69_tft_touch/Kconfig.esp32s3_1_69_tft_touch
```kconfig
# Copyright (c) 2024 Joel Guittet
# SPDX-License-Identifier: Apache-2.0

config BOARD_ESP32S3_1_69_TFT_TOUCH
	select SOC_ESP32S3_WROOM_N16R8
	select SOC_ESP32S3_PROCPU if BOARD_ESP32S3_1_69_TFT_TOUCH_ESP32S3_PROCPU
	select SOC_ESP32S3_APPCPU if BOARD_ESP32S3_1_69_TFT_TOUCH_ESP32S3_APPCPU
```

## sdk/waveshare/esp32s3_1_69_tft_touch/board.yml
```yaml
board:
  name: esp32s3_1_69_tft_touch
  full_name: ESP32-S3-1.69 TFT Touch
  vendor: waveshare
  socs:
  - name: esp32s3
```

## sdk/waveshare/esp32s3_1_8_amoled_touch/Kconfig
```kconfig
# Copyright (c) 2024 Joel Guittet
# SPDX-License-Identifier: Apache-2.0

config HEAP_MEM_POOL_ADD_SIZE_BOARD
	int
	default 4096 if BOARD_ESP32S3_1_8_AMOLED_TOUCH_ESP32S3_PROCPU
	default 256 if BOARD_ESP32S3_1_8_AMOLED_TOUCH_ESP32S3_APPCPU
```

## sdk/waveshare/esp32s3_1_8_amoled_touch/board.yml
```yaml
board:
  name: esp32s3_1_8_amoled_touch
  full_name: ESP32-S3-1.8-AMOLED-Touch
  vendor: waveshare
  socs:
  - name: esp32s3
```
