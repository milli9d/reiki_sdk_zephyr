## sdk/boards/waveshare/esp32s3_1_8_amoled_touch/esp32s3_1_8_amoled_touch_esp32s3_procpu_defconfig
```kconfig
# Copyright (c) 2024 Joel Guittet
# SPDX-License-Identifier: Apache-2.0
# waveshare 1.8 AMOELED touch
# https://files.waveshare.com/wiki/ESP32-S3-Touch-AMOLED-1.8/ESP32-S3-Touch-AMOLED-1.8.pdf

CONFIG_CONSOLE=y
CONFIG_SERIAL=y
CONFIG_UART_CONSOLE=y
CONFIG_GPIO=y

CONFIG_SPI=y
CONFIG_DMA=y
CONFIG_I2C=y

CONFIG_DISPLAY=y
CONFIG_SH8601=y
CONFIG_DISPLAY_INIT_PRIORITY=90

CONFIG_INPUT=y
CONFIG_INPUT_FT3168=y
CONFIG_INPUT_FT3168_INTERRUPT=y

CONFIG_REGULATOR=y

CONFIG_REGULATOR_AXP192_AXP2101_INIT_PRIORITY=86

CONFIG_GPIO_TCA9544APWR=y
CONFIG_GPIO_TCA9544APWR_INIT_PRIORITY=87

CONFIG_SENSOR=y
CONFIG_SENSOR_SHELL=y

CONFIG_RTC=y
CONFIG_RTC_PCF85063A=y
CONFIG_RTC_SHELL=y
```

## sdk/dts/bindings/display/shenge,sh8601-common.yaml
```yaml
# Copyright (c) 2026 Milind Singh
# SPDX-License-Identifier: Apache-2.0

title: SH8601 AMOLED display controller

include: ["display-controller.yaml"]

properties:
  reset-gpios:
    type: phandle-array
    description: |
      RESX pin of the controller. The controller treats this as an
      active-low signal, so describe it as GPIO_ACTIVE_LOW. If absent, a
      software reset is issued instead.

  pixel-format:
    type: int
    default: 32
    enum:
      - 1  # PANEL_PIXEL_FORMAT_RGB_888
      - 32 # PANEL_PIXEL_FORMAT_RGB_565X
    description: |
      Initial pixel format. The controller expects 16-bit pixels most
      significant byte first, which is PIXEL_FORMAT_RGB_565X in Zephyr.

  x-offset:
    type: int
    default: 0
    description: Column offset in pixels of the panel within controller memory.

  y-offset:
    type: int
    default: 0
    description: Row offset in pixels of the panel within controller memory.

  red-blue-swap:
    type: boolean
    description: Panel is wired BGR; set the BGR bit in the address mode register.
```

## sdk/dts/bindings/display/shenge,sh8601-mspi.yaml
```yaml
# Copyright (c) 2026 Milind Singh
# SPDX-License-Identifier: Apache-2.0

description: |
  SH8601 AMOLED display controller on an MSPI bus.

  Commands are written as opcode 0x02 + {0x00, CMD, 0x00} on one line.
  Pixel data uses mspi-io-mode: MSPI_IO_MODE_SINGLE writes with opcode 0x02
  on one line, MSPI_IO_MODE_QUAD_1_1_4 writes with opcode 0x32 and the data
  phase on four lines.

compatible: "shenge,sh8601"

include: ["mspi-device.yaml", "shenge,sh8601-common.yaml"]

examples:
  - |
    #include <zephyr/dt-bindings/display/panel.h>

    &spi2 {
      sh8601@0 {
        compatible = "shenge,sh8601";
        reg = <0>;
        mspi-max-frequency = <40000000>;
        mspi-io-mode = "MSPI_IO_MODE_QUAD_1_1_4";
        width = <368>;
        height = <448>;
        pixel-format = <PANEL_PIXEL_FORMAT_RGB_565X>;
      };
    };
```

## sdk/dts/bindings/display/shenge,sh8601-spi.yaml
```yaml
# Copyright (c) 2026 Milind Singh
# SPDX-License-Identifier: Apache-2.0

description: |
  SH8601 AMOLED display controller on a single-line SPI bus.

  The controller's QSPI interface frames every access as an opcode byte
  (0x02) followed by a 24-bit address carrying the DCS command
  ({0x00, CMD, 0x00}), followed by the command parameters or pixel data.
  On this bus everything, including pixel data, is shifted out on SDA/D0.

compatible: "shenge,sh8601"

include: ["spi-device.yaml", "shenge,sh8601-common.yaml"]

examples:
  - |
    #include <zephyr/dt-bindings/display/panel.h>

    &spi2 {
      sh8601@0 {
        compatible = "shenge,sh8601";
        reg = <0>;
        spi-max-frequency = <40000000>;
        width = <368>;
        height = <448>;
        pixel-format = <PANEL_PIXEL_FORMAT_RGB_565X>;
      };
    };
```

## sdk/dts/bindings/mspi/espressif,esp32-mspi.yaml
```yaml
# Copyright (c) 2026 Milind Singh
# SPDX-License-Identifier: Apache-2.0

description: |
  ESP32 general purpose SPI (GPSPI) peripheral used as an MSPI controller.

  The command, address, dummy and data phases of an MSPI transfer map onto
  the native GPSPI phases, each with its own line count (1, 2 or 4), so
  modes such as MSPI_IO_MODE_QUAD_1_1_4 run as single hardware transactions.
  Transfers are always half-duplex.

  Reuse an existing SPI node by overriding its compatible:

    &spi2 {
      compatible = "espressif,esp32-mspi";
      pinctrl-0 = <&mspi2_default>;
      pinctrl-names = "default";
      #address-cells = <1>;
      #size-cells = <0>;
      status = "okay";
    };

compatible: "espressif,esp32-mspi"

include: [mspi-controller.yaml, pinctrl-device.yaml]

properties:
  reg:
    required: true

  clocks:
    required: true

  interrupts:
    required: true

  pinctrl-0:
    required: true

  pinctrl-names:
    required: true

  dma-host:
    type: int
    required: true
    description: GPSPI host index, 0 -> SPI2 (FSPI), 1 -> SPI3.

  use-iomux:
    type: boolean
    description: |
      Pins are routed through IO_MUX rather than the GPIO matrix, which
      allows clock rates above 40 MHz and changes input timing compensation.

  cs-setup-time:
    type: int
    default: 0
    description: Chip select setup time in SPI clock cycles.

  cs-hold-time:
    type: int
    default: 0
    description: Chip select hold time in SPI clock cycles.
```
