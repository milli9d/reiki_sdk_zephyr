/*
* Copyright (c) 2025 Espressif Systems (Shanghai) Co., Ltd.
*
* SPDX-License-Identifier: Apache-2.0
*/
#include <mem.h>
#include <freq.h>
#include <zephyr/dt-bindings/gpio/gpio.h>
#include <zephyr/dt-bindings/interrupt-controller/esp-esp32c6-intmux.h>
#include <zephyr/dt-bindings/clock/esp32c6_clock.h>
#include <dt-bindings/pinctrl/esp32c6-pinctrl.h>

/ {
    #address-cells = <1>;
    #size-cells = <1>;
    
    soc {
        #address-cells = <1>;
        #size-cells = <1>;
        compatible = "simple-bus";
        ranges;
        
        lp_uart: uart@600b1400 {
            compatible = "espressif,esp32-lpuart";
            reg = <0x600b1400 DT_SIZE_K(4)>;
            status = "disabled";
        };
        
        lp_gpio: gpio@600b2000 {
            compatible = "espressif,esp32-gpio";
            gpio-controller;
            #gpio-cells = <2>;
            reg = <0x600b2000 DT_SIZE_K(4)>;
            ngpios = <8>;
        };
    };
};
