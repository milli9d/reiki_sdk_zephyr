## dts/bindings/sensor/qorvo,qmi8658c.yaml
```yaml
description: Qorvo QMI8658C IMU

compatible: "qorvo,qmi8658c"

include: 
    - name: i2c-device.yaml
    #  property-allowlist:
    #  property-blocklist:
    - name: sensor-device.yaml
    #  property-allowlist:
    #  property-blocklist:

properties:
  int1-gpios:
    type: phandle-array
    description: |
      GPIO connected to the IMU INT1 output. This signal is open-drain, active low.

  int2-gpios:
    type: phandle-array
    description: |
      GPIO connected to the IMU INT2 output. This signal is open-drain, active low.
```

## sdk/boards/waveshare/esp32c6_1_47_tft/Kconfig
```kconfig
# Copyright (c) 2024 Joel Guittet
# SPDX-License-Identifier: Apache-2.0

config HEAP_MEM_POOL_ADD_SIZE_BOARD
	int
	default 4096 if BOARD_ESP32C6_1_47_TFT_ESP32C6_HPCORE
	default 256 if BOARD_ESP32C6_1_47_TFT_ESP32C6_LPCORE
```

## sdk/boards/waveshare/esp32c6_1_47_tft/Kconfig.defconfig
```kconfig
# Copyright (c) 2024 Joel Guittet
# SPDX-License-Identifier: Apache-2.0

if BOARD_ESP32C6_1_47_TFT_ESP32C6_HPCORE

config KERNEL_MEM_POOL
	default y

endif # BOARD_ESP32C6_1_47_TFT_ESP32C6_HPCORE
```

## sdk/boards/waveshare/esp32c6_1_47_tft/Kconfig.esp32c6_1_47_tft
```kconfig
# Copyright (c) 2024 Joel Guittet
# SPDX-License-Identifier: Apache-2.0

config BOARD_ESP32C6_1_47_TFT
	select SOC_ESP32_C6_WROOM_1U_N8
	select SOC_ESP32C6_HPCORE if BOARD_ESP32C6_1_47_TFT_ESP32C6_HPCORE
	select SOC_ESP32C6_LPCORE if BOARD_ESP32C6_1_47_TFT_ESP32C6_LPCORE
```

## sdk/boards/waveshare/esp32c6_1_47_tft/board.yml
```yaml
board:
  name: esp32c6_1_47_tft
  full_name: ESP32-C6-1.47
  vendor: waveshare
  socs:
  - name: esp32c6
```

## sdk/boards/waveshare/esp32c6_1_47_tft/esp32c6_1_47_tft_esp32c6_hpcore_defconfig
```kconfig
# SPDX-License-Identifier: Apache-2.0
# ===========================================================================
# SoC Configuration
# ESP32-C6FH4 4 MB (Quad SPI) v0.0/v0.1/v0.2
# ===========================================================================

# RAM Composition
CONFIG_HEAP_MEM_POOL_SIZE=4096

# Flash Memory Configuration
CONFIG_ESPTOOLPY_FLASHMODE_QIO=y
CONFIG_ESPTOOLPY_FLASHFREQ_80M=y
CONFIG_ESPTOOLPY_FLASHSIZE_4MB=y
CONFIG_SOC_FLASH_ESP32=y

# Debug settings
CONFIG_CONSOLE=y
CONFIG_SERIAL=y
CONFIG_UART_CONSOLE=y

# ===========================================================================
# Peripherals
# ===========================================================================

CONFIG_DISPLAY=y

CONFIG_FLASH=y
CONFIG_FLASH_MAP=y

CONFIG_DISK_ACCESS=y
CONFIG_DISK_DRIVER_SDMMC=y
CONFIG_FAT_FILESYSTEM_ELM=y
CONFIG_FILE_SYSTEM_MKFS=y
CONFIG_FS_FATFS_MOUNT_MKFS=y

CONFIG_GPIO=y

# CONFIG_I2C=y

# CONFIG_SPI=y
```

## sdk/dts/bindings/input/focaltech,ft3168.yaml
```yaml
# Copyright (c) 2025 Qingsong Gou <gouqs@hotmail.com>
# SPDX-License-Identifier: Apache-2.0

description: FocalTech FT3168 capacitive touch controller

compatible: "focaltech,ft3168"

include: [i2c-device.yaml, touchscreen-common.yaml]

properties:
  int-gpios:
    type: phandle-array
    description: Interrupt GPIO specification, active low

  reset-gpios:
    type: phandle-array
    description: Reset GPIO specification, active low
```
